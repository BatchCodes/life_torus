## firmware/life_torus/main/Kconfig.projbuild
```kconfig
# SPDX-License-Identifier: GPL-3.0-or-later
menu "Life Torus"

    choice LIFE_MODE
        prompt "Firmware mode"
        default LIFE_MODE_GAME
        help
            Game: the normal Game of Life display.

            Bring-up: test patterns for a new display. Use it to check the wiring, to find
            the panel layout options and to measure the current. Refer to
            docs/hardware/bring-up.md.

        config LIFE_MODE_GAME
            bool "Game"
        config LIFE_MODE_BRINGUP
            bool "Bring-up"
    endchoice

    menu "Display hardware"

        config LIFE_BOARDS
            int "Number of 32x8 boards"
            range 1 16
            default 8
            help
                The number of LED boards in the ring. Each board adds 8 columns, so 8 boards
                make 64 columns. The phone app can change it later, then the display restarts.

        config LIFE_PIN_DIN
            int "DIN GPIO"
            range 0 48
            default 11
            help
                GPIO for the DIN (data) line of the first board, through the 74AHCT125.

        config LIFE_PIN_CLK
            int "CLK GPIO"
            range 0 48
            default 12
            help
                GPIO for the CLK (clock) line of all boards, through the 74AHCT125.

        config LIFE_PIN_CS
            int "CS (LOAD) GPIO"
            range 0 48
            default 10
            help
                GPIO for the CS (LOAD) line of all boards, through the 74AHCT125.

        config LIFE_SPI_CLOCK_KHZ
            int "SPI clock (kHz)"
            range 100 10000
            default 2000
            help
                The MAX7219 accepts up to 10 MHz. The CLK and CS wires go to all eight
                boards, so a lower clock is more reliable. Reduce it if cells flicker at
                random.

        config LIFE_INTENSITY
            int "MAX7219 intensity (0 to 15)"
            range 0 15
            default 4
            help
                The brightness of all LEDs. A higher value uses more current. With one
                5 V 3 A USB-C input, keep it at 4 or less. With two inputs, up to 8. Refer
                to docs/hardware/power-and-wiring.md.

        config LIFE_BRIGHTNESS_LEVELS
            bool "Variable brightness"
            default y
            help
                Born cells bright, surviving cells normal, cells that die in the next
                generation dim. The firmware shows 3 sub-frames in a loop to make the
                levels. Turn it off if the display flickers. Then each live cell has the
                same brightness.

        config LIFE_SUBFRAME_MS
            int "Sub-frame time (ms)"
            range 1 20
            default 3
            help
                The time that each of the 3 sub-frames shows. 3 ms gives a full cycle of
                9 ms (111 Hz).

        config LIFE_REINIT_MS
            int "Display re-init period (ms)"
            range 0 60000
            default 5000
            help
                Write the MAX7219 start-up registers again at this period, to recover from
                a glitch on the supply or the wires. 0: never.

        menu "Panel layout"

            config LIFE_PANEL_REVERSE_RING
                bool "Chain goes right to left around the ring"
                default n

            config LIFE_PANEL_FLIP_BOARDS
                bool "All boards upside down (input connector at the top)"
                default n

            config LIFE_PANEL_ZIGZAG
                bool "Every second board turned by 180 degrees"
                default n

            config LIFE_PANEL_BLOCK_TRANSPOSE
                bool "8x8 block: swap rows and columns"
                default n

            config LIFE_PANEL_BLOCK_FLIP_X
                bool "8x8 block: mirror left to right"
                default n

            config LIFE_PANEL_BLOCK_FLIP_Y
                bool "8x8 block: mirror top to bottom"
                default n

        endmenu

    endmenu

    menu "Game"
        visible if LIFE_MODE_GAME

        config LIFE_STEP_MS
            int "Step time in run (ms)"
            range 20 5000
            default 100
            help
                The time between two generations. 100 ms gives 10 generations per second.

        config LIFE_SETTLED_LIMIT
            int "Settled board limit (generations)"
            range 1 100000
            default 30
            help
                In run, a settled board for this number of generations loads a new preset.
                Settled: empty, nothing moves, or the board flips between two states
                (period 2).

        config LIFE_NO_INPUT_LIMIT
            int "No-input limit (generations)"
            range 1 1000000
            default 10000
            help
                In run, this number of generations with no button press loads a new preset.

        config LIFE_REPEAT_LIMIT
            int "Repeat limit (generations)"
            range 0 100000
            default 300
            help
                In run, a board that repeats with a period of 3 to 32 generations (for
                example only pulsars) for this number of generations loads a new preset.
                Shorter periods are the settled board limit. 0: off.

        config LIFE_PAUSE_TIMEOUT_MS
            int "Pause timeout (ms)"
            range 1000 3600000
            default 30000
            help
                Pause with no button press for this time changes to run.

        config LIFE_TRANSITION_MS
            int "New preset wipe time (ms)"
            range 0 10000
            default 800

        config LIFE_CURSOR_BLINK_MS
            int "Cursor blink half period (ms)"
            range 50 2000
            default 250

        config LIFE_DPAD_REPEAT_DELAY_MS
            int "D-pad repeat delay (ms)"
            range 50 2000
            default 300
            help
                A held D-pad button moves the cursor again after this time.

        config LIFE_DPAD_REPEAT_INTERVAL_MS
            int "D-pad repeat interval (ms)"
            range 20 1000
            default 80

        config LIFE_KO_SCROLL_MS
            int "Ko code effect duration (ms)"
            range 1000 60000
            default 10000

        config LIFE_KO_GAP_MS
            int "Ko code button gap (ms)"
            range 200 10000
            default 2000

        choice LIFE_EDGE
            prompt "Edges of the empty and random presets"
            default LIFE_EDGE_TORUS
            help
                Torus: the grid wraps around the ring and from the top to the bottom.
                Cylinder: the grid wraps around the ring only. The other presets have their
                own edge mode.

            config LIFE_EDGE_TORUS
                bool "Torus"
            config LIFE_EDGE_CYLINDER
                bool "Cylinder"
        endchoice

        config LIFE_RANDOM_PERCENT
            int "Random preset fill (%)"
            range 1 99
            default 30

        config LIFE_WIFI
            bool "Wi-Fi and phone app"
            default y
            help
                Make an open Wi-Fi network for the phone app. Wi-Fi uses approximately
                100 mA more.

        config LIFE_WIFI_SSID
            string "Wi-Fi network name"
            default "LIFE-TORUS"
            depends on LIFE_WIFI

        config LIFE_WEB_PASSWORD
            string "Phone app password"
            default "life"
            help
                The password of the phone app. Set your own in sdkconfig.local, which git
                ignores. The settings page of the app can change it too.

        config LIFE_LOG_CONTROLLER_REPORTS
            bool "Log raw controller reports"
            default n
            help
                Log each USB controller report as hex. Use it to check a new controller.

    endmenu

    config LIFE_MODE_BUTTON
        bool "Mode button"
        default y
        help
            A push button from a GPIO to GND. Each press moves to the next display mode.
            With no button connected, the internal pull-up keeps the GPIO high, so nothing
            happens.

    config LIFE_PIN_MODE_BUTTON
        int "Mode button GPIO"
        range 0 48
        default 7
        depends on LIFE_MODE_BUTTON

    menu "Microphone (beat sync)"

        config LIFE_MIC
            bool "Look for an INMP441 microphone"
            default y
            help
                At start-up, the firmware checks for an INMP441 I2S microphone. With a
                microphone, the display modes (not Game of Life) sync to the beat of music.
                With no microphone, nothing changes.

        config LIFE_PIN_MIC_SCK
            int "Microphone SCK GPIO"
            range 0 48
            default 4
            depends on LIFE_MIC

        config LIFE_PIN_MIC_WS
            int "Microphone WS GPIO"
            range 0 48
            default 5
            depends on LIFE_MIC

        config LIFE_PIN_MIC_SD
            int "Microphone SD GPIO"
            range 0 48
            default 6
            depends on LIFE_MIC

    endmenu

    menu "Bring-up"
        visible if LIFE_MODE_BRINGUP

        config LIFE_BRINGUP_AUTO_ADVANCE_S
            int "Next test pattern after (s)"
            range 0 600
            default 8
            help
                With no controller, the bring-up firmware shows each test pattern for this
                time. The first button press stops the automatic change. 0: never.

    endmenu

endmenu
```
